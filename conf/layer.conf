## conf/layer.conf
```bitbake
# We have a conf and classes directory, add to BBPATH
BBPATH .= ":${LAYERDIR}"

# We have recipes-* directories, add to BBFILES
BBFILES += "${LAYERDIR}/recipes-*/*/*.bb \
	${LAYERDIR}/recipes-*/*/*.bbappend"

BBFILE_COLLECTIONS += "update-project"
BBFILE_PATTERN_custom = "^${LAYERDIR}/"
BBFILE_PRIORITY_custom = "7" 

# Enablinng swupdate for the entire layer
LAYERDEPENDS_swupdate-boards = "swupdate"

# setting viable Yocto versions for this layer
LAYERSERIES_COMPAT_swupdate-boards = "dunfell gatesgarth hardknott"
```
